## sdkconfig.defaults
```kconfig
# Target
CONFIG_IDF_TARGET="esp32s3"

# Flash size
CONFIG_ESPTOOLPY_FLASHSIZE_4MB=y
CONFIG_ESPTOOLPY_FLASHSIZE="4MB"

# PSRAM
CONFIG_SPIRAM=y
CONFIG_SPIRAM_MODE_OCT=y
CONFIG_SPIRAM_SPEED_80M=y
CONFIG_SPIRAM_USE_CAPS_ALLOC=y
CONFIG_SPIRAM_USE_MALLOC=y
CONFIG_SPIRAM_TRY_ALLOCATE_WIFI_LWIP=y

# LVGL
CONFIG_LV_USE_ST7789=y
CONFIG_LV_USE_ILI9341=n
CONFIG_LV_USE_ST7735=n
CONFIG_LV_USE_ST7796=n
CONFIG_LV_USE_ILI9481=n
CONFIG_LV_USE_ILI9488=n
CONFIG_LV_USE_ILI9486=n
CONFIG_LV_USE_SSD1963=n
CONFIG_LV_USE_RM68120=n
CONFIG_LV_USE_SH8601=n

# LVGL Display buffer
CONFIG_LV_DISP_DEF_REFR_PERIOD=16
CONFIG_LV_INDEV_DEF_READ_PERIOD=16
CONFIG_LV_USE_PERF_MONITOR=n
CONFIG_LV_USE_MEM_MONITOR=n

# LVGL Fonts
CONFIG_LV_FONT_MONTSERRAT_24=y

# LVGL Theme
CONFIG_LV_USE_THEME_DEFAULT=y
CONFIG_LV_THEME_DEFAULT_DARK=n

# NVS
CONFIG_NVS_ENCRYPTION=n

# Partition Table
CONFIG_PARTITION_TABLE_CUSTOM=y
CONFIG_PARTITION_TABLE_CUSTOM_FILENAME="partitions.csv"
CONFIG_PARTITION_TABLE_FILENAME="partitions.csv"

# FreeRTOS
CONFIG_FREERTOS_HZ=1000

Task Watchdog - 增大超时防止 LVGL 大面积渲染时触发
CONFIG_ESP_TASK_WDT_TIMEOUT_S=10

# Main task stack size
CONFIG_ESP_MAIN_TASK_STACK_SIZE=8192

# Log level
CONFIG_LOG_DEFAULT_LEVEL_INFO=y

# Linker orphan section handling (ESP-IDF v6.x compatibility)
CONFIG_LINKER_ORPHAN_SECTION_WARNING=y

# LittleFS
CONFIG_LITTLEFS_PAGE_SIZE=256
CONFIG_LITTLEFS_BLOCK_SIZE=4096
CONFIG_LITTLEFS_BLOCK_CYCLES=512
CONFIG_LITTLEFS_CACHE_SIZE=512
CONFIG_LITTLEFS_LOOKAHEAD_SIZE=128
CONFIG_LITTLEFS_MAX_PARTITIONS=3
```
